/*

Copyright (c) 2002
Other World Computing
All rights reserved

Redistribution and use in source and binary forms, with or without modification,
are permitted provided that the following conditions are met:

1. Redistributions of source code must retain the above copyright notice,
   this list of conditions and the following disclaimer as the first lines of
   each file.

2. Redistributions in binary form must reproduce the above copyright notice,
   this list of conditions and the following disclaimer in the documentation and/or
   other materials provided with the distribution.

3. Redistributions in binary form must retain the link to Other World
   Computing's web site in the application's "About Box."

This software is provided by Other World Computing ``as is'' and any express or implied
warranties, including, but not limited to, the implied warranties of
merchantability and fitness for a particular purpose are disclaimed. In no event
shall Ryan Rempel or Other World Computing be liable for any direct, indirect,
incidental, special, exemplary, or consequential damages (including, but not
limited to, procurement of substitute goods or services; loss of use, data, or
profits; or business interruption) however caused and on any theory of
liability, whether in contract, strict liability, or tort (including negligence
or otherwise) arising in any way out of the use of this software, even if
advised of the possibility of such damage.

*/

#include "NVRAMValue.h"
#include "XPFErrors.h"

#include <stdio.h>

// NVRAMValue

NVRAMValue::NVRAMValue (const char *name, unsigned offset)
{
	fOffset = offset;
	fStringValue = NULL;
	fName = NewPtr (strlen (name) + 1);
	strcpy (fName, name);
}

NVRAMValue::~NVRAMValue ()
{
	if (fName) DisposePtr (fName);
	if (fStringValue) DisposePtr (fStringValue);
}

void
NVRAMValue::setInternalStringValue (const char *value)
{
	if (fStringValue) DisposePtr (fStringValue);
	fStringValue = NewPtr (strlen (value) + 1);
	strcpy (fStringValue, value);
}

// NVRAMBooleanValue

NVRAMBooleanValue::NVRAMBooleanValue (const char *name, unsigned offset)
	: NVRAMValue (name, offset)
{
	fType = kBooleanValue;
	fValue = false;
	setInternalStringValue ("false");
}

bool
NVRAMBooleanValue::getBooleanValue ()
{
	return fValue;
}

long
NVRAMBooleanValue::getNumericValue ()
{
	ThrowException_AC (kWrongNVRAMType, 0);
	return 0;
}

bool
NVRAMBooleanValue::setBooleanValue (const bool value)
{
	if (fValue == value) return false;
	fValue = value;
	setInternalStringValue (value ? "true" : "false");
	return true;
}

bool
NVRAMBooleanValue::setNumericValue (const long value)
{
	#pragma unused (value)
	ThrowException_AC (kWrongNVRAMType, 0);
	return false;
}

bool
NVRAMBooleanValue::setStringValue (const char *value)
{
	if (!strcmp (value, "false")) {
		return setBooleanValue (false);
	} else if (!strcmp (value, "true")) {
		return setBooleanValue (true);
	} else {
		ThrowException_AC (kWrongNVRAMType, 0);
	}
	return false;
}

// NVRAMUnsignedValue

NVRAMNumericValue::NVRAMNumericValue (const char *name, unsigned offset)
	: NVRAMValue (name, offset)
{
	fType = kNumericValue;
	fValue = 0;
	setInternalStringValue ("0");
}

bool
NVRAMNumericValue::getBooleanValue ()
{
	ThrowException_AC (kWrongNVRAMType, 0);
	return false;
}

long
NVRAMNumericValue::getNumericValue ()
{
	return fValue;
}

bool
NVRAMNumericValue::setBooleanValue (const bool value)
{
	#pragma unused (value)
	ThrowException_AC (kWrongNVRAMType, 0);
	return false;
}

bool
NVRAMNumericValue::setNumericValue (const long value)
{
	if (fValue == value) return false;
	fValue = value;
	char stringValue[16];
	snprintf (stringValue, 16, "%d", value);
	setInternalStringValue (stringValue);
	return true;
}

bool
NVRAMNumericValue::setStringValue (const char *value)
{
	return setNumericValue (strtol (value, NULL, 10));
}

// NVRAMStringValue

NVRAMStringValue::NVRAMStringValue (const char *name, unsigned offset)
	: NVRAMValue (name, offset)
{
	fType = kStringValue;
	setInternalStringValue ("");
}

bool
NVRAMStringValue::getBooleanValue ()
{
	ThrowException_AC (kWrongNVRAMType, 0);
	return false;
}

long
NVRAMStringValue::getNumericValue ()
{
	ThrowException_AC (kWrongNVRAMType, 0);
	return 0;
}

bool
NVRAMStringValue::setBooleanValue (const bool value)
{
	#pragma unused (value)
	ThrowException_AC (kWrongNVRAMType, 0);
	return false;
}

bool
NVRAMStringValue::setNumericValue (const long value)
{
	#pragma unused (value)
	ThrowException_AC (kWrongNVRAMType, 0);
	return false;
}

bool
NVRAMStringValue::setStringValue (const char *value)
{
	if (fStringValue && !strcmp (fStringValue, value)) return false;	
	setInternalStringValue (value);
	return true;
}
